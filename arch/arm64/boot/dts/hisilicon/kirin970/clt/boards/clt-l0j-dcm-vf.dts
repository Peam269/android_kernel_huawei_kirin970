/dts-v1/;

/include/ "../variants/clt-l0j.dtsi"

/ {
	hisi,boardid = <0x06 0x05 0x04 0x09>;
	hisi,boardname = "CHARLOTTE_DCM_VF";
	hisi,modem_id = <0x3903f000>;
	hisi,product_id = <0x3903f000>;
};

/include/ "../overlays/clt-l0j-dcm-vf.dtsi"
