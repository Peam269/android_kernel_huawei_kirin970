/dts-v1/;

/include/ "../variants/clt-lx9.dtsi"

/ {
	hisi,boardid = <0x06 0x05 0x03 0x06>;
	hisi,boardname = "CHARLOTTE_LX9_V4";
	hisi,modem_id = <0x39034400>;
	hisi,product_id = <0x39034400>;
};

/include/ "../overlays/clt-lx9-v4.dtsi"
