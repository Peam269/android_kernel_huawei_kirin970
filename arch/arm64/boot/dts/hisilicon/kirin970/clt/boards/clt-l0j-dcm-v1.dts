/dts-v1/;

/include/ "../variants/clt-l0j.dtsi"

/ {
	hisi,boardid = <0x06 0x05 0x02 0x04>;
	hisi,boardname = "CHARLOTTE_DCM_V1";
	hisi,modem_id = <0x39038c00>;
	hisi,product_id = <0x39038c00>;
};

/include/ "../overlays/clt-l0j-dcm-v1.dtsi"
