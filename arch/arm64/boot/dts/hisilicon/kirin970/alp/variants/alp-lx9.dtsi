/include/ "../alp-common.dtsi"

/ {
	hisi,product_name = "ALPS-LX9";

	sensorhub {
		sar {
			sar1 {
				status = "ok";
			};
		};

		rpc {
			phandle = <0x58b>;

			rpc {
				compatible = "huawei,rpc";
				file_id = <0x18>;
				sensor_list_info_id = <0x18>;
				sensor_type = "rpc";
				sensorlist_name = "rpc";
				mask = <0x0f 0x63f 0x63f 0x63f 0x63e 0x63c 0x63e 0x63c 0x63e 0x63c 0x20f 0x20f 0x20f 0x20f 0x20f 0x20f 0x20f 0x20f 0xffff 0xffff 0xffff 0xffff 0xffff 0xffff 0xffff 0xffff 0xffff 0xffff 0xffff 0xffff 0xffff 0xffff>;
				table = <0x00 0x217 0x227 0x207 0x212 0x214 0x222 0x224 0x202 0x204 0x201 0x01 0x02 0x03 0x04 0x05 0x06 0x07 0xffff 0xffff 0xffff 0xffff 0xffff 0xffff 0xffff 0xffff 0xffff 0xffff 0xffff 0xffff 0xffff 0xffff>;
				default_value = <0x1d>;
				status = "ok";
			};
		};
	};

	sensorhub_ex {
		phandle = <0x58c>;
	};

	sensorhub_io_power {
		phandle = <0x58d>;
	};

	ddrflux {
		phandle = <0x58e>;
	};

	hisee@0x0 {
		phandle = <0x58f>;
	};

	pcie_kport {
		phandle = <0x590>;
	};

	pcie_kport_rc@0xf4000000 {
		phandle = <0x591>;
	};

	pcie_kport_ep@0xf4000000 {
		phandle = <0x592>;
	};

	ivp_smmu@e8dc0000 {
		phandle = <0x593>;
	};

	hisi_ivp {
		phandle = <0x594>;
	};

	hisi_ivp_ipc {
		phandle = <0x595>;
	};

	secs_power_ctrl {
		phandle = <0x596>;
	};

	hw,pmucurr_test {
		phandle = <0x597>;
	};

	battery {
		phandle = <0x598>;
	};

	hisi_battery {
		phandle = <0x599>;
	};

	chg_watchdog {
		phandle = <0x59a>;
	};

	direct_charge_ps {
		phandle = <0x59b>;
	};

	huawei_charger {
		phandle = <0x59c>;
	};

	vbus_monitor {
		phandle = <0x59d>;
	};

	vbus_channel_charger {
		phandle = <0x59e>;
	};

	vbus_channel_boost_gpio {
		phandle = <0x59f>;
	};

	soc_decimal {
		phandle = <0x5a0>;
	};

	power_thermalzone {
		phandle = <0x5a1>;
	};

	temp_control {
		phandle = <0x5a2>;
	};

	bat_heating {
		phandle = <0x5a3>;
	};

	btb_check {
		phandle = <0x5a4>;
	};

	wireless_charger {
		phandle = <0x5a5>;
	};

	boost_5v {
		phandle = <0x5a6>;
	};

	wired_channel_switch {
		phandle = <0x5a7>;
	};

	ovp_channel_switch {
		phandle = <0x5a8>;
	};

	ncp3902_channel_switch {
		phandle = <0x5a9>;
	};

	vbat_ovp {
		phandle = <0x5aa>;
	};

	direct_charger {
		phandle = <0x5ab>;
	};

	dual_loadswitch {
		phandle = <0x5ac>;
	};

	retail_demo_capacity_limit_control {
		phandle = <0x5ad>;
	};

	charging_core {
		phandle = <0x5ae>;
	};

	huawei_batt_soh {
		phandle = <0x5af>;
	};

	coul_core {
		phandle = <0x5b0>;
	};

	hisi_coul_test {
		phandle = <0x5b1>;
	};

	soft_isc {
		phandle = <0x5b2>;
	};

	fastboot_battery {
		phandle = <0x5b3>;
	};

	fastboot_charger {
		phandle = <0x5b4>;
	};

	fastboot_charge_vibrate {
		phandle = <0x5b5>;
	};

	usb_short_circuit_protect {
		phandle = <0x5b6>;
	};

	desayatl_3900_39k_4400 {
		phandle = <0x5b7>;
	};

	scudlg_3900_200k_4400_25 {
		phandle = <0x5b8>;
	};

	sunwodasony_3900_110k_4400_15 {
		phandle = <0x5b9>;
	};

	powerhal@0 {
		phandle = <0x5ba>;
	};

	weights@0 {
		phandle = <0x5bb>;
	};

	tsens@0 {
		phandle = <0x5bc>;
	};

	hisi_tm@1 {
		phandle = <0x5bd>;
	};

	shell_frame@0 {
		phandle = <0x5be>;
	};

	shell_front@0 {
		phandle = <0x5bf>;
	};

	shell_back@0 {
		phandle = <0x5c0>;
	};

	hisi_ambient@0 {
		phandle = <0x5c1>;
	};

	pddevice {
		phandle = <0x5c2>;
	};

	test_regu_ip@0xFFF35000 {
		phandle = <0x5c3>;
	};

	framebuffer@E8600000 {
		phandle = <0x5c4>;
	};

	chosen {
		phandle = <0x5c5>;
	};

	timerslice@0xFFF0A000 {
		phandle = <0x5c6>;
	};

	ipc_hisi_modem@0xFF011000 {
		phandle = <0x5c7>;
	};

	ipc_hisi_modem_s@0xFF010000 {
		phandle = <0x5c8>;
	};

	ipc_hisi_v230_mdm@0xFFF21000 {
		phandle = <0x5c9>;
	};

	sysctrl_app {
		phandle = <0x5ca>;
	};

	cp_reset@0 {
		phandle = <0x5cb>;
	};

	sysctrl_fiq {
		phandle = <0x5cc>;
	};

	mperf@mem {
		phandle = <0x5cd>;
	};

	dsp@49000000 {
		phandle = <0x5ce>;
	};

	socp1@ff060000 {
		phandle = <0x5cf>;
	};

	socp1@mem {
		phandle = <0x5d0>;
	};

	deflate1@ff061000 {
		phandle = <0x5d1>;
	};

	coresight-etm-cp {
		ptm@EC0FC000 {
			phandle = <0x5d2>;
		};

		ptm@EC0FD000 {
			phandle = <0x5d3>;
		};
	};

	coresight-tmc-cp-es {
		etf@EC081000 {
			phandle = <0x5d4>;
		};

		etf@EC082000 {
			phandle = <0x5d5>;
		};
	};

	coresight-etm-cp-es {
		ptm@EC0BC000 {
			phandle = <0x5d6>;
		};

		ptm@EC0BD000 {
			phandle = <0x5d7>;
		};
	};

	apr_config {
		drv_info {
			phandle = <0x5d8>;
		};

		osa_info {
			phandle = <0x5d9>;
		};

		pam_info {
			phandle = <0x5da>;
		};

		cttf_info {
			phandle = <0x5db>;
		};

		cas_info {
			phandle = <0x5dc>;
		};

		cproc_info {
			phandle = <0x5dd>;
		};

		guas_info {
			phandle = <0x5de>;
		};

		gunas_info {
			phandle = <0x5df>;
		};

		gudsp_info {
			phandle = <0x5e0>;
		};

		tlps_info {
			phandle = <0x5e1>;
		};

		tldsp_info {
			phandle = <0x5e2>;
		};

		cphy_info {
			phandle = <0x5e3>;
		};

		rtt_info {
			phandle = <0x5e4>;
		};

		cnas_info {
			phandle = <0x5e5>;
		};

		ims_info {
			phandle = <0x5e6>;
		};

		rtosck_info {
			phandle = <0x5e7>;
		};
	};

	dlock_irq {
		phandle = <0x5e8>;
	};

	bus_state {
		phandle = <0x5e9>;
	};

	bus_reset_reg {
		phandle = <0x5ea>;
	};

	ipf1@ff038000 {
		phandle = <0x5eb>;
	};

	psam1@ff040000 {
		phandle = <0x5ec>;
	};

	hw_soundtrigger_event {
		phandle = <0x5ed>;
	};

	audio_hw_config {
		phandle = <0x5ee>;
	};

	deviceboxID@0 {
		phandle = <0x5ef>;
	};

	smartpakit {
		phandle = <0x5f0>;
	};

	anc_hs@0 {
		phandle = <0x5f1>;
	};

	invert_hs@0 {
		phandle = <0x5f2>;
	};

	extern_dac_vir_dai@0 {
		phandle = <0x5f3>;
	};

	tfa98xx_ioctl {
		phandle = <0x5f4>;
	};

	gps_power {
		phandle = <0x5f5>;
	};

	peripherals {
		phandle = <0x5f6>;

		clk6250khz {
			phandle = <0x5f7>;
		};
	};

	jpu@E8301000 {
		phandle = <0x5f8>;
	};

	lcdkit_default_auo_otm1901a_5p2_1080p_video_default {
		phandle = <0x5f9>;
	};

	lcdkit_alps_tugl_auo_otm1901a_5p2_1080p_video_default {
		phandle = <0x5fa>;
	};

	lcdkit_alps_tugl_auo_otm1901a_5p2_1080p_video_default_1 {
		phandle = <0x5fb>;
	};

	lcdkit_alps_tugl_auo_otm1901a_5p2_1080p_video_default_2 {
		phandle = <0x5fc>;
	};

	lcdkit_alps_tugl_jdi_2lane_nt36860c {
		phandle = <0x5fd>;
	};

	lcdkit_alps_tugl_jdi_nt36860_5p88 {
		phandle = <0x5fe>;
	};

	lcdkit_alps_tugl_jdi_nt36860_temp {
		phandle = <0x5ff>;
	};

	lcdkit_alps_tugl_jdi_nt36860c_cut2 {
		phandle = <0x600>;
	};

	lcdkit_alps_tugl_lgd_2lane_nt36870 {
		phandle = <0x601>;
	};

	lcdkit_alps_tugl_lgd_nt36870_vn1 {
		phandle = <0x602>;
	};

	lcdkit_alps_tugl_sharp_2lane_nt36870 {
		phandle = <0x603>;
	};

	lcdkit_alps_tugl_sharp_nt36870_5p88 {
		phandle = <0x604>;
	};

	lcdkit_alps_tugl_sharp_nt36870_vn1 {
		phandle = <0x605>;
	};

	a1@0xFF012000 {
		phandle = <0x606>;
	};

	psci {
		phandle = <0x607>;
	};

	hw_connectivity {
		phandle = <0x608>;
	};

	devcheck {
		phandle = <0x609>;
	};

	hall {
		phandle = <0x60a>;
	};

	irda_maxim {
		phandle = <0x60b>;
	};

	pd_dpm {
		phandle = <0x60c>;
	};

	huawei_usb {
		phandle = <0x60d>;
	};

	huawei_usbvbus {
		phandle = <0x60e>;
	};

	bluetooth_power {
		phandle = <0x60f>;
	};

	bluetooth_sleep {
		phandle = <0x610>;
	};

	usbswitch {
		phandle = <0x611>;
	};

	bastet {
		phandle = <0x612>;
	};

	hifi_virtual_voice_proxy {
		phandle = <0x613>;
	};

	rootparam {
		phandle = <0x614>;
	};

	cpufreq-bL {
		phandle = <0x615>;
	};

	fastboot_buckboost {
		phandle = <0x616>;
	};

	huawei_cpu_buck {
		phandle = <0x617>;
	};

	huawei_hi6422v200_pmu1 {
		phandle = <0x618>;
	};

	huawei_hi6422v200_pmu2 {
		phandle = <0x619>;
	};

	huawei_smpl {
		phandle = <0x61a>;
	};

	fastboot_recovery {
		phandle = <0x61b>;
	};

	hisi_vibrator@fff34000 {
		phandle = <0x61c>;
	};

	fastboot {
		phandle = <0x61d>;
	};

	pmu@FFF34000 {
		phandle = <0x61e>;
	};

	sysctrl@fff0a000 {
		phandle = <0x61f>;
	};

	pctrl@e8a09000 {
		phandle = <0x620>;
	};

	crgctrl@fff35000 {
		phandle = <0x621>;
	};

	crgctrl@0xFFD7e000 {
		phandle = <0x622>;
	};

	pmctrl@fff31000 {
		phandle = <0x623>;
	};

	media1ctrl@e87FF000 {
		phandle = <0x624>;
	};

	media2ctrl@e8900000 {
		phandle = <0x625>;
	};

	hisi_axierr {
		phandle = <0x626>;
	};

	hisi_reset {
		phandle = <0x627>;
	};

	uartctl {
		phandle = <0x628>;
	};

	nfc_exist {
		phandle = <0x629>;
	};

	hisi_gpio_key {
		phandle = <0x62a>;
	};

	dp_aux_switch {
		phandle = <0x62b>;
	};

	panel_pwm {
		phandle = <0x62c>;
	};

	panel_blpwm {
		phandle = <0x62d>;
	};

	panel_lcdc_fake {
		phandle = <0x62e>;
	};

	panel_mipi_fake {
		phandle = <0x62f>;
	};

	panel_hdmi_fake {
		phandle = <0x630>;
	};

	panel_dp_fake {
		phandle = <0x631>;
	};

	sound_DA_combine_v3 {
		phandle = <0x632>;
	};

	hi6210_hifi {
		phandle = <0x633>;
	};

	hisi_dp_machine {
		phandle = <0x634>;
	};

	asp_hdmi_dmac@E804B400 {
		phandle = <0x635>;
	};

	asp_cfg@0xe804e000 {
		phandle = <0x636>;
	};

	dp_i2s {
		phandle = <0x637>;
	};

	dp_audio@0 {
		phandle = <0x638>;
	};

	hisi-pcm-dp {
		phandle = <0x639>;
	};

	asp_irq@E804E000 {
		phandle = <0x63a>;
	};

	slimbus_dai@0 {
		phandle = <0x63b>;
	};

	sio@E804F000 {
		phandle = <0x63c>;
	};

	sio@E804F400 {
		phandle = <0x63d>;
	};

	sio@E804F800 {
		phandle = <0x63e>;
	};

	sio@E804FC00 {
		phandle = <0x63f>;
	};

	soundtrigger@E804B000 {
		phandle = <0x640>;
	};

	hi64xx_asp_dmac@E804B000 {
		phandle = <0x641>;
	};

	hifidsp {
		phandle = <0x642>;
	};

	sochifi_watchdog {
		phandle = <0x643>;
	};

	asp_dmac@E804B000 {
		phandle = <0x644>;
	};

	usbaudio_dsp {
		phandle = <0x645>;
	};

	anc_hs_default@0 {
		phandle = <0x646>;
	};

	sensorhub_status {
		phandle = <0x647>;
	};

	sensorhub_nmi {
		phandle = <0x648>;
	};

	huawei,hisi_fd {
		phandle = <0x649>;
	};

	hisi,hisi_camera {
		phandle = <0x64a>;
	};

	huawei,imx486hybird {
		phandle = <0x64b>;
	};

	huawei,imx319 {
		phandle = <0x64c>;
	};

	huawei,imx386hybird {
		phandle = <0x64d>;
	};

	huawei,camera_ldo {
		phandle = <0x64e>;
	};

	bcm_wifi {
		phandle = <0x64f>;
	};

	bcm_bt {
		phandle = <0x650>;
	};

	fingerprint {
		phandle = <0x651>;
	};

	irda {
		phandle = <0x652>;
	};

	touchscreen {
		phandle = <0x653>;
	};

	huawei_dual_charger {
		phandle = <0x654>;
	};

	sec_pinmux@fff11800 {
		gpio216_cfg_func {
			pinctrl-single,pins = <0x71c 0x00>;
			pinctrl-single,bias-pulldown = <0x00 0x02 0x00 0x02>;
			pinctrl-single,bias-pullup = <0x00 0x01 0x00 0x01>;
			pinctrl-single,drive-strength = <0x20 0x70>;
			pinctrl-single,slew-rate = <0x00 0x80>;
			phandle = <0x655>;
		};

		gpio216_cfg_idle {
			pinctrl-single,pins = <0x71c 0x00>;
			pinctrl-single,bias-pulldown = <0x00 0x02 0x00 0x02>;
			pinctrl-single,bias-pullup = <0x00 0x01 0x00 0x01>;
			pinctrl-single,drive-strength = <0x20 0x70>;
			pinctrl-single,slew-rate = <0x00 0x80>;
			phandle = <0x656>;
		};

		gpio213_cfg_func {
			phandle = <0x657>;
		};

		gpio213_cfg_idle {
			phandle = <0x658>;
		};

		gpio214_cfg_func {
			phandle = <0x659>;
		};

		gpio214_cfg_idle {
			phandle = <0x65a>;
		};
	};

	modem_pinctrl {
		compatible = "arm,modem_pinctrl";
		pinctrl-names = "init", "default", "idle";
		pinctrl-0 = <0x06 0x04 0x94 0x03 0x98 0x01 0xffff 0xffff 0x06 0x05 0x98 0x03 0x9c 0x00 0xffff 0xffff 0x07 0x02 0xac 0x02 0xb0 0x00 0xffff 0xffff 0x07 0x03 0xb0 0x01 0xb4 0x00 0xffff 0xffff 0x07 0x04 0xb4 0x01 0xb8 0x00 0xffff 0xffff 0x07 0x05 0xb8 0x01 0xbc 0x00 0xffff 0xffff 0x07 0x06 0xbc 0x01 0xc0 0x00 0xffff 0xffff 0x07 0x07 0xc0 0x01 0xc4 0x00 0xffff 0xffff 0x08 0x00 0xc4 0x01 0xc8 0x00 0x01 0x00 0x08 0x01 0xc8 0x01 0xcc 0x00 0x01 0x00 0x08 0x02 0xcc 0x01 0xd0 0x00 0xffff 0xffff 0x08 0x03 0xd0 0x01 0xd4 0x00 0xffff 0xffff 0x08 0x04 0xd4 0x01 0xd8 0x00 0xffff 0xffff 0x08 0x05 0xd8 0x01 0xdc 0x00 0xffff 0xffff 0x08 0x06 0xdc 0x01 0xe0 0x00 0xffff 0xffff 0x08 0x07 0xe0 0x01 0xe4 0x00 0xffff 0xffff 0x09 0x00 0xe4 0x01 0xe8 0x00 0xffff 0xffff 0x09 0x01 0xe8 0x01 0xec 0x00 0xffff 0xffff 0x09 0x02 0xec 0x01 0xf0 0x00 0xffff 0xffff 0x09 0x03 0xf0 0x01 0xf4 0x00 0xffff 0xffff 0x09 0x04 0xf4 0x01 0xf8 0x00 0xffff 0xffff 0x09 0x05 0xf8 0x01 0xfc 0x00 0xffff 0xffff 0x09 0x06 0xfc 0x01 0x100 0x00 0xffff 0xffff 0x09 0x07 0x100 0x01 0x104 0x00 0xffff 0xffff 0x0a 0x00 0x104 0x01 0x108 0x00 0xffff 0xffff 0x0a 0x01 0x108 0x01 0x10c 0x00 0xffff 0xffff 0x0a 0x02 0x10c 0x01 0x110 0x00 0xffff 0xffff 0x0a 0x03 0x110 0x01 0x114 0x00 0xffff 0xffff 0x0a 0x04 0x114 0x01 0x118 0x00 0xffff 0xffff 0x0a 0x05 0x118 0x01 0x11c 0x00 0xffff 0xffff 0x0a 0x06 0x11c 0x02 0x120 0x00 0xffff 0xffff 0x0a 0x07 0x120 0x02 0x124 0x02 0xffff 0xffff 0x0b 0x00 0x124 0x01 0x128 0x00 0xffff 0xffff 0x0b 0x01 0x128 0x01 0x12c 0x00 0xffff 0xffff 0x0b 0x02 0x12c 0x01 0x130 0x00 0xffff 0xffff 0x0b 0x03 0x130 0x01 0x134 0x00 0xffff 0xffff 0x0b 0x04 0x134 0x01 0x138 0x00 0xffff 0xffff 0x0b 0x05 0x138 0x01 0x13c 0x00 0xffff 0xffff 0x0b 0x06 0x13c 0x01 0x140 0x00 0xffff 0xffff 0x0b 0x07 0x140 0x01 0x144 0x00 0xffff 0xffff 0x0c 0x00 0x144 0x01 0x148 0x00 0xffff 0xffff 0x12 0x05 0xac 0x03 0xdc 0x00 0xffff 0xffff 0x18 0x05 0x4c 0x00 0x78 0x01 0x00 0xffff 0x19 0x06 0x70 0x00 0x9c 0x00 0x00 0xffff 0x1a 0x07 0x718 0x01 0x718 0x02 0x01 0x00>;
		pinctrl-1 = <0x06 0x04 0x94 0x03 0x98 0x01 0xffff 0xffff 0x06 0x05 0x98 0x03 0x9c 0x00 0xffff 0xffff 0x07 0x02 0xac 0x02 0xb0 0x00 0xffff 0xffff 0x07 0x03 0xb0 0x01 0xb4 0x00 0xffff 0xffff 0x07 0x04 0xb4 0x01 0xb8 0x00 0xffff 0xffff 0x07 0x05 0xb8 0x01 0xbc 0x00 0xffff 0xffff 0x07 0x06 0xbc 0x01 0xc0 0x00 0xffff 0xffff 0x07 0x07 0xc0 0x01 0xc4 0x00 0xffff 0xffff 0x08 0x00 0xc4 0xffff 0xc8 0xffff 0xffff 0xffff 0x08 0x01 0xc8 0x01 0xcc 0x00 0x01 0x00 0x08 0x02 0xcc 0x01 0xd0 0x00 0xffff 0xffff 0x08 0x03 0xd0 0x01 0xd4 0x00 0xffff 0xffff 0x08 0x04 0xd4 0x01 0xd8 0x00 0xffff 0xffff 0x08 0x05 0xd8 0x01 0xdc 0x00 0xffff 0xffff 0x08 0x06 0xdc 0x01 0xe0 0x00 0xffff 0xffff 0x08 0x07 0xe0 0x01 0xe4 0x00 0xffff 0xffff 0x09 0x00 0xe4 0x01 0xe8 0x00 0xffff 0xffff 0x09 0x01 0xe8 0x01 0xec 0x00 0xffff 0xffff 0x09 0x02 0xec 0x01 0xf0 0x00 0xffff 0xffff 0x09 0x03 0xf0 0x01 0xf4 0x00 0xffff 0xffff 0x09 0x04 0xf4 0x01 0xf8 0x00 0xffff 0xffff 0x09 0x05 0xf8 0x01 0xfc 0x00 0xffff 0xffff 0x09 0x06 0xfc 0x01 0x100 0x00 0xffff 0xffff 0x09 0x07 0x100 0x01 0x104 0x00 0xffff 0xffff 0x0a 0x00 0x104 0x01 0x108 0x00 0xffff 0xffff 0x0a 0x01 0x108 0x01 0x10c 0x00 0xffff 0xffff 0x0a 0x02 0x10c 0x01 0x110 0x00 0xffff 0xffff 0x0a 0x03 0x110 0x01 0x114 0x00 0xffff 0xffff 0x0a 0x04 0x114 0x01 0x118 0x00 0xffff 0xffff 0x0a 0x05 0x118 0x01 0x11c 0x00 0xffff 0xffff 0x0a 0x06 0x11c 0x02 0x120 0x00 0xffff 0xffff 0x0a 0x07 0x120 0x02 0x124 0x02 0xffff 0xffff 0x0b 0x00 0x124 0x01 0x128 0x00 0xffff 0xffff 0x0b 0x01 0x128 0x01 0x12c 0x00 0xffff 0xffff 0x0b 0x02 0x12c 0x01 0x130 0x00 0xffff 0xffff 0x0b 0x03 0x130 0x01 0x134 0x00 0xffff 0xffff 0x0b 0x04 0x134 0x01 0x138 0x00 0xffff 0xffff 0x0b 0x05 0x138 0x01 0x13c 0x00 0xffff 0xffff 0x0b 0x06 0x13c 0x01 0x140 0x00 0xffff 0xffff 0x0b 0x07 0x140 0x01 0x144 0x00 0xffff 0xffff 0x0c 0x00 0x144 0x01 0x148 0x00 0xffff 0xffff 0x12 0x05 0xac 0x03 0xdc 0x00 0xffff 0xffff 0x18 0x05 0x4c 0xffff 0x78 0xffff 0x00 0xffff 0x19 0x06 0x70 0x00 0x9c 0x00 0x00 0xffff 0x1a 0x07 0x718 0xffff 0x718 0xffff 0xffff 0xffff>;
		pinctrl-2 = <0x06 0x04 0x94 0x03 0x98 0x01 0xffff 0xffff 0x06 0x05 0x98 0x03 0x9c 0x00 0xffff 0xffff 0x07 0x02 0xac 0x02 0xb0 0x00 0xffff 0xffff 0x07 0x03 0xb0 0x01 0xb4 0x00 0xffff 0xffff 0x07 0x04 0xb4 0x01 0xb8 0x00 0xffff 0xffff 0x07 0x05 0xb8 0x01 0xbc 0x00 0xffff 0xffff 0x07 0x06 0xbc 0x01 0xc0 0x00 0xffff 0xffff 0x07 0x07 0xc0 0x01 0xc4 0x00 0xffff 0xffff 0x08 0x00 0xc4 0xffff 0xc8 0xffff 0xffff 0xffff 0x08 0x01 0xc8 0x00 0xcc 0x00 0x00 0x00 0x08 0x02 0xcc 0x01 0xd0 0x00 0xffff 0xffff 0x08 0x03 0xd0 0x01 0xd4 0x00 0xffff 0xffff 0x08 0x04 0xd4 0x01 0xd8 0x00 0xffff 0xffff 0x08 0x05 0xd8 0x01 0xdc 0x00 0xffff 0xffff 0x08 0x06 0xdc 0x01 0xe0 0x00 0xffff 0xffff 0x08 0x07 0xe0 0x01 0xe4 0x00 0xffff 0xffff 0x09 0x00 0xe4 0x01 0xe8 0x00 0xffff 0xffff 0x09 0x01 0xe8 0x01 0xec 0x00 0xffff 0xffff 0x09 0x02 0xec 0x01 0xf0 0x00 0xffff 0xffff 0x09 0x03 0xf0 0x01 0xf4 0x00 0xffff 0xffff 0x09 0x04 0xf4 0x01 0xf8 0x00 0xffff 0xffff 0x09 0x05 0xf8 0x01 0xfc 0x00 0xffff 0xffff 0x09 0x06 0xfc 0x01 0x100 0x00 0xffff 0xffff 0x09 0x07 0x100 0x01 0x104 0x00 0xffff 0xffff 0x0a 0x00 0x104 0x01 0x108 0x00 0xffff 0xffff 0x0a 0x01 0x108 0x01 0x10c 0x00 0xffff 0xffff 0x0a 0x02 0x10c 0x01 0x110 0x00 0xffff 0xffff 0x0a 0x03 0x110 0x01 0x114 0x00 0xffff 0xffff 0x0a 0x04 0x114 0x01 0x118 0x00 0xffff 0xffff 0x0a 0x05 0x118 0x01 0x11c 0x00 0xffff 0xffff 0x0a 0x06 0x11c 0x02 0x120 0x00 0xffff 0xffff 0x0a 0x07 0x120 0x02 0x124 0x02 0xffff 0xffff 0x0b 0x00 0x124 0x01 0x128 0x00 0xffff 0xffff 0x0b 0x01 0x128 0x01 0x12c 0x00 0xffff 0xffff 0x0b 0x02 0x12c 0x01 0x130 0x00 0xffff 0xffff 0x0b 0x03 0x130 0x01 0x134 0x00 0xffff 0xffff 0x0b 0x04 0x134 0x01 0x138 0x00 0xffff 0xffff 0x0b 0x05 0x138 0x01 0x13c 0x02 0xffff 0xffff 0x0b 0x06 0x13c 0x01 0x140 0x00 0xffff 0xffff 0x0b 0x07 0x140 0x01 0x144 0x00 0xffff 0xffff 0x0c 0x00 0x144 0x01 0x148 0x00 0xffff 0xffff 0x12 0x05 0xac 0x03 0xdc 0x00 0xffff 0xffff 0x18 0x05 0x4c 0xffff 0x78 0xffff 0xffff 0xffff 0x19 0x06 0x70 0x00 0x9c 0x00 0x00 0xffff 0x1a 0x07 0x718 0xffff 0x718 0xffff 0xffff 0xffff>;
		pinctrl-num = <0x2d 0x2d 0x2d>;
		status = "ok";
		phandle = <0x65b>;
	};

	__symbols__ {
		rpc_sensor = "/sensorhub/rpc";
		gpio216_cfg_func = "/sec_pinmux@fff11800/gpio216_cfg_func";
		gpio216_cfg_idle = "/sec_pinmux@fff11800/gpio216_cfg_idle";
		gpio213_cfg_func = "/sec_pinmux@fff11800/gpio213_cfg_func";
		gpio213_cfg_idle = "/sec_pinmux@fff11800/gpio213_cfg_idle";
		gpio214_cfg_func = "/sec_pinmux@fff11800/gpio214_cfg_func";
		gpio214_cfg_idle = "/sec_pinmux@fff11800/gpio214_cfg_idle";
		modem_pinctrl = "/modem_pinctrl";
	};
};
