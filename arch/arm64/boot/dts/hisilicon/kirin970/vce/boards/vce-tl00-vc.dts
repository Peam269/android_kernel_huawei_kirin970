/dts-v1/;

/include/ "../variants/vce-tl00.dtsi"

/ {
	hisi,boardid = <0x06 0x09 0x07 0x06>;
	hisi,boardname = "VCE_TL00_VC";
	hisi,modem_id = <0x39651000>;
	hisi,product_name = "VCE-TL00";

	pinmux@e896c800 {
		gpio030_cfg_func {
			pinctrl-single,bias-pulldown = <0x02 0x02 0x00 0x02>;
		};

		gpio030_cfg_idle {
			pinctrl-single,bias-pulldown = <0x02 0x02 0x00 0x02>;
		};
	};
};
